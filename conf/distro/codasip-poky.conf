## conf/distro/codasip-poky.conf
```bitbake
require conf/distro/poky.conf

DISTRO_NAME = "Codasip Poky Distro"
DISTRO_VERSION = "1.7.0-pre"
TARGET_VENDOR = "-codasip"
DISTRO = "codasip-poky"
DISTROOVERRIDES = "poky"

SDK_VERSION = "R1.7.0-pre"
IMAGE_VERSION_SUFFIX = "-R1.7.0-pre"

# Build with clang where possible
TOOLCHAIN = "clang"

# Use meta-clang to provide llvm rather than core
PREFERRED_PROVIDER_llvm = "clang"
PREFERRED_PROVIDER_llvm-native = "clang-native"
PREFERRED_PROVIDER_nativesdk-llvm = "nativesdk-clang"
PROVIDES:pn-clang = "llvm"
PROVIDES:pn-clang-native = "llvm-native"
PROVIDES:pn-nativesdk-clang = "nativesdk-llvm"

# Include clang in SDK
CLANGSDK = "1"

# MACHINE_FEATURES (after careful consideration) we don't want included
MACHINE_FEATURES_BACKFILL_CONSIDERED = "rtc qemu-usermode"

QEMUVERSION ?= "8.2%"

# We only care about RISC-V targets, but we need x86_64 for building
QEMU_TARGETS ?= "riscv32 riscv64 x86_64"
```

## conf/layer.conf
```bitbake
# We have a conf and classes directory, add to BBPATH
BBPATH .= ":${LAYERDIR}"

# We have recipes-* directories, add to BBFILES
BBFILES += "${LAYERDIR}/recipes-*/*/*.bb ${LAYERDIR}/recipes-*/*/*.bbappend"

BBFILE_COLLECTIONS += "meta-codasip"
BBFILE_PATTERN_meta-codasip = "^${LAYERDIR}/"
BBFILE_PRIORITY_meta-codasip = "1"

# This should only be incremented on significant changes that will
# cause compatibility issues with other layers
LAYERVERSION_meta-codasip = "1"

LAYERSERIES_COMPAT_meta-codasip = "nanbield"

LICENSE_PATH += "${LAYERDIR}/licenses"

CODASIP_GIT_REPO ?= "git@gitlab.codasip.com/cheri/software/cherilinux"
CODASIP_GIT_PROTOCOL ?= "ssh"
CODASIP_GIT_BRANCH ?= "hobgoblin"
BB_BASEHASH_IGNORE_VARS:append = " CODASIP_GIT_REPO CODASIP_GIT_PROTOCOL CODASIP_GIT_BRANCH"

BAREMETAL_DEPLOY_DIR = "${TOPDIR}/tmp-baremetal/deploy/images/${MACHINE}"
```

## conf/machine/hobgoblin.conf
```bitbake
#@TYPE: Machine
#@NAME: hobgoblin
#@SOC: Codasip A70x
#@DESCRIPTION: Machine configuration for the Hobgoblin platform

# require include/riscv-common.inc
require conf/machine/include/riscv/tune-riscv.inc

# Adds openSBI dependencies but also changes UBOOT_ENV_SUFFIX
# require ../../../meta-riscv/conf/machine/include/riscv-common.inc


#============================================
# Preferred Providers
PREFERRED_PROVIDER_virtual/kernel ?= "linux-hobgoblin"
PREFERRED_PROVIDER_virtual/bootloader ?= "u-boot-hobgoblin"
#============================================

#============================================
# Kernel Configuration
KERNEL_DEVICETREE ?= " \
    codasip/a70x-hobgoblin.dtb \
    codasip/a70x-hobgoblin-axi-emac.dtb \
    codasip/a70x-hobgoblin-etherlite.dtb \
    codasip/a70x-hobgoblin-qemu.dtb \
"
KERNEL_CLASSES = "kernel"
KERNEL_IMAGETYPE = "Image.gz"
KERNEL_IMAGETYPES = "Image"
#============================================

#============================================
# Image Configuration
EXTRA_IMAGEDEPENDS += "opensbi u-boot-hobgoblin hobgoblin-bootfiles"
do_image_wic[depends] += " \
  opensbi:do_deploy \
  u-boot-hobgoblin:do_deploy \
  hobgoblin-bootfiles:do_deploy \
  ${@ bb.utils.contains('DISTRO_FEATURES', 'secure-boot', ' \
    secure-boot-tools-native:do_populate_sysroot \
    secure-boot-tools:do_deploy \
  ', '', d) } \
"

# Bitbake variables we pass to the wic source bootimg-codasip plugin
# We have to pass COREBASE through as well so that it can find
# bootimg-partition.py
WICVARS:append = " \
  COREBASE \
  CODASIP_SECURE_BOOT \
  CODASIP_DTB \
  CODASIP_OPENSBI \
  CODASIP_RUNTIME \
  CODASIP_IMGS \
  CODASIP_KERNEL_LOADADDR \
"

CODASIP_SECURE_BOOT = "${@ bb.utils.contains('DISTRO_FEATURES', 'secure-boot', '1', '0', d) }"
CODASIP_KERNEL_LOADADDR = "0x81000000"

# The next 4 CODASIP_* variables list the files to be
# used in the boot process. When CODASIP_SECURE_BOOT==0
# the files are copied into the boot partition, and
# added to "config.txt".
# When CODASIP_SECURE_BOOT == 1 they are built into the
# boot image, signed, and written to "flash.bin".
CODASIP_DTB = "a70x-hobgoblin.dtb:0x87000000"
CODASIP_OPENSBI = "fw_dynamic.bin:0x80000000"
CODASIP_RUNTIME = "u-boot.bin-${@ bb.utils.contains('DISTRO_FEATURES', 'secure-boot', 'secure-boot', 'mmc', d) }:0x80200000"
CODASIP_IMGS = " \
  ${@ bb.utils.contains('DISTRO_FEATURES', 'secure-boot', ' \
    ${KERNEL_IMAGETYPE}:${CODASIP_KERNEL_LOADADDR} \
  ', '', d) } \
"

# Files to install in the boot partition
# Format: src;dest
# bootimg-codasip special case: *.scr.pp;*.scr.uimg are
# preprocessed, expanding @{variable[:word[:field]]}@
IMAGE_BOOT_FILES = " \
    a70x-hobgoblin.dtb \
    a70x-hobgoblin-axi-emac.dtb \
    a70x-hobgoblin-etherlite.dtb \
    a70x-hobgoblin-qemu.dtb \
    ${@ bb.utils.contains('DISTRO_FEATURES', 'secure-boot', '', ' \
      ${KERNEL_IMAGETYPE} \
      boot-mmc.scr.pp;boot.scr.uimg \
    ', d) } \
"

WIC_CREATE_EXTRA_ARGS ?= "--no-fstab-update"
# WIC_CREATE_EXTRA_ARGS += " --debug "
WKS_FILE_DEPENDS ?= " \
    opensbi \
    e2fsprogs-native \
    bmap-tools-native \
    u-boot-tools-native \
"
WKS_FILE ?= "hobgoblin.wks"
#============================================

#============================================
# SBI Configuration
RISCV_SBI_PLAT = "generic"
# RISCV_SBI_PAYLOAD ?= "u-boot.bin"
#============================================

#============================================
# Uboot Configuration
UBOOT_CONFIG = "secure-boot mmc"
UBOOT_CONFIG[mmc] = "codasip-a70x-hobgoblin_smode_defconfig"
UBOOT_CONFIG[secure-boot] = "codasip-a70x-hobgoblin_secure-boot_smode_defconfig"
UBOOT_ENTRYPOINT = "0x80200000"
#============================================

#============================================
# Machine Features
MACHINE_FEATURES = "serial"
SERIAL_CONSOLES = "115200;ttyS0"
USE_VT=""
#============================================
```

## wic/hobgoblin.wks
```
# short-description: Create SD card image for the Codasip Hobgoblin FPGA platform

part /boot --source bootimg-codasip --ondisk mmcblk0 --fstype=vfat --label boot --active --size=100M --align 4096
part / --source rootfs --ondisk mmcblk0 --fstype=ext4 --label root --size=64M --align 4096

bootloader --ptable msdos
```
